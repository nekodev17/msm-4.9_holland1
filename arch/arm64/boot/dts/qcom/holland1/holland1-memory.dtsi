/* Copyright (c) 2021, The Linux Foundation. All rights reserved.
*
* This program is free software; you can redistribute it and/or modify
* it under the terms of the GNU General Public License version 2 and
* only version 2 as published by the Free Software Foundation.
*
* This program is distributed in the hope that it will be useful,
* but WITHOUT ANY WARRANTY; without even the implied warranty of
* MERCHANTABILITY or FITNESS FOR A PARTICULAR PURPOSE.  See the
* GNU General Public License for more details.
*/

/{
    reserved-memory {

	    other_ext_mem: other_ext_region@0 {

	    	reg = <0x0 0x84A00000 0x0 0x1E00000>;
	    };

		ramoops@b0000000 {
			compatible = "ramoops";
			reg = <0 0xb0000000 0 0x400000>;
			record-size = <0x200000>;
			console-size = <0x200000>;
		};
    };
};
